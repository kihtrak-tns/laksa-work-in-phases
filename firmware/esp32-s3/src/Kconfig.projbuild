## firmware/esp32-s3/src/Kconfig.projbuild
```kconfig
menu "LAKSA vehicle configuration"

config LAKSA_WEB_DASHBOARD
    bool "Enable read-only Wi-Fi diagnostics dashboard"
    default n
    help
        Builds and starts a read-only Wi-Fi/HTTP dashboard. Disable this for a
        micro-ROS-only deployment to omit the Wi-Fi, TCP/IP and HTTP server
        dependencies from the application.

config LAKSA_ROS_DOMAIN_ID
    int "ROS domain ID"
    range 0 232
    default 0

endmenu
```
